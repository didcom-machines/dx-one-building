## sources/meta-didcom-bsp/conf/distro/automotive-infotainment.conf
```bitbake
# Automotive Infotainment Distribution Configuration
# Compatible with: dx-one-dart-mx95, dx-one-dart-mx8mp
# Based on NXP i.MX Release Distro settings with automotive customizations

require conf/distro/poky.conf

DISTRO = "automotive-infotainment"
DISTRO_NAME = "Automotive Infotainment DIDCOM Distribution"
DISTRO_VERSION = "1.0"
DISTRO_CODENAME = "automotive-infotainment"
DISTROOVERRIDES = "fsl"

MAINTAINER = "Manuel Monge <manuel.monge@didcom.com.mx>"

# NXP i.MX base settings
POKY_DEFAULT_DISTRO_FEATURES:remove = "${POKY_DEFAULT_DISTRO_FEATURES_IMX_REMOVE}"
POKY_DEFAULT_DISTRO_FEATURES_IMX_REMOVE ?= ""

# Enable Wayland and automotive features
POKY_DEFAULT_DISTRO_FEATURES:append = " wayland virtualization"
DISTRO_FEATURES:append:mx8-nxp-bsp = " virtualization"
SKIP_META_VIRT_SANITY_CHECK = "1"
SKIP_META_SECURITY_SANITY_CHECK = "1"
SKIP_META_TPM_SANITY_CHECK = "1"

# Set generic tuning for our supported machines
DEFAULTTUNE:mx8m-nxp-bsp ?= "armv8a-crc-crypto"
DEFAULTTUNE:mx95-nxp-bsp ?= "armv8a-crc-crypto"

# Use systemd as init manager
POKY_INIT_MANAGER = "systemd"
VIRTUAL-RUNTIME_init_manager = "systemd"
DISTRO_FEATURES_BACKFILL_CONSIDERED = "sysvinit"

# Container runtime
VIRTUAL-RUNTIME_container_runtime = "virtual-runc"

# Add automotive-specific features
DISTRO_FEATURES:append = " \
    automotive \
    multimedia \
    opengl \
    pam \
    mono \
"

# Remove features not needed for automotive
DISTRO_FEATURES:remove = " \
    x11 \
    directfb \
    pulseaudio \
"

# Virtualization and containerization support (Docker)
VIRTUAL-RUNTIME_container_runtime = "docker"

# Package configurations from NXP
PACKAGECONFIG:append:pn-gstreamer1.0-plugins-ugly = " x264"
PACKAGECONFIG:append:pn-mesa-demos = " ${@bb.utils.filter('DISTRO_FEATURES', 'wayland', d)}"
PACKAGECONFIG:remove:pn-mesa-demos = "vulkan"
PACKAGECONFIG:append:pn-perf = " jevents"

# Wayland/Weston configuration
PACKAGECONFIG:append:pn-weston = " rdp kms"
PACKAGECONFIG:append:pn-weston-init = " rdp"

# Kernel configuration - using Variscite's kernel for now
# PREFERRED_PROVIDER_virtual/kernel = "linux-dx-one"
# PREFERRED_VERSION_linux-dx-one = "6.6%"

# Package management
PACKAGE_CLASSES = "package_deb"

# Security and safety features
EXTRA_IMAGE_FEATURES:append = " \
    read-only-rootfs \
"
```

## sources/meta-didcom-bsp/conf/layer.conf
```bitbake
# We have a conf and classes directory, add to BBPATH
BBPATH .= ":${LAYERDIR}"

# We have recipes-* directories, add to BBFILES
BBFILES += "${LAYERDIR}/recipes-*/*/*.bb \
            ${LAYERDIR}/recipes-*/*/*.bbappend"

BBFILE_COLLECTIONS += "meta-didcom-bsp"
BBFILE_PATTERN_meta-didcom-bsp = "^${LAYERDIR}/"
BBFILE_PRIORITY_meta-didcom-bsp = "10"

LAYERDEPENDS_meta-didcom-bsp = "core"
LAYERSERIES_COMPAT_meta-didcom-bsp = "scarthgap"
```

## sources/meta-didcom-bsp/conf/machine/dx-one-dart-mx8mp.conf
```bitbake
#@TYPE: Machine
#@NAME: DX-ONE DART-MX8M-PLUS
#@SOC: i.MX8MP
#@DESCRIPTION: Machine configuration for DART-MX8M-PLUS
#@MAINTAINER: Manuel Monge <manuel.monge@didcom.com.mx>

# Include base Variscite DART-MX8M-PLUS configuration
require conf/machine/imx8mp-var-dart.conf

# Add both base and custom machine to overrides so BitBake finds Variscite's files
MACHINEOVERRIDES =. "imx8mp-var-dart:dx-one-dart-mx8mp:"

# DX-ONE specific customizations
# (Add any custom settings here as needed)
```

## sources/meta-didcom-bsp/conf/machine/dx-one-dart-mx95.conf
```bitbake
#@TYPE: Machine
#@NAME: DX-ONE DART-MX95
#@SOC: i.MX95
#@DESCRIPTION: DX-ONE DART-MX95 configuration
#@MAINTAINER: Manuel Monge <manuel.monge@didcom.com.mx>

# Include base Variscite DART-MX95 configuration
require conf/machine/imx95-var-dart.conf

# Add both base and custom machine to overrides so BitBake finds Variscite's files
MACHINEOVERRIDES =. "imx95-var-dart:dx-one-dart-mx95:"

# DX-ONE specific customizations
# (Add any custom settings here as needed)
```

## sources/meta-didcom-bsp/conf/machine/dx-one-rpi-zero2w.conf
```bitbake
#@TYPE: Machine
#@NAME: DX-ONE Raspberry Pi Zero 2W
#@SOC: BCM2837
#@DESCRIPTION: DX-ONE configuration for Raspberry Pi Zero 2W (development/testing)
#@MAINTAINER: Manuel Monge <manuel.monge@didcom.com.mx>

# Inherit from base Raspberry Pi Zero 2W 64-bit configuration
require conf/machine/raspberrypi0-2w-64.conf

MACHINEOVERRIDES =. "dx-one-rpi-zero2w:"

# Machine-specific features
MACHINE_FEATURES += "wifi bluetooth"
```
